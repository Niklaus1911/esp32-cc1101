## boards/esp32s3-devkitc-n16r8/sdkconfig.defaults
```kconfig
CONFIG_PLATFORM_BOARD_ESP32S3_DEVKITC_N16R8=y
CONFIG_ESPTOOLPY_FLASHSIZE_16MB=y
CONFIG_ESP_CONSOLE_UART_DEFAULT=y
CONFIG_ESP_CONSOLE_SECONDARY_NONE=y
CONFIG_PARTITION_TABLE_CUSTOM_FILENAME="boards/esp32s3-devkitc-n16r8/partitions.csv"
CONFIG_CC1101_SPI_SCLK_GPIO=12
CONFIG_CC1101_SPI_MISO_GPIO=13
CONFIG_CC1101_SPI_MOSI_GPIO=11
CONFIG_CC1101_SPI_CS_GPIO=10
CONFIG_CC1101_GDO0_GPIO=4
CONFIG_CC1101_GDO2_GPIO=5
# CONFIG_RF_ACTIVITY_LED_ENABLE is not set
```

## boards/esp32s3-supermini-fh4r2/sdkconfig.defaults
```kconfig
CONFIG_PLATFORM_BOARD_ESP32S3_SUPERMINI_FH4R2=y
CONFIG_ESPTOOLPY_FLASHSIZE_4MB=y
CONFIG_SPIRAM_MODE_QUAD=y
CONFIG_ESP_CONSOLE_USB_SERIAL_JTAG=y
CONFIG_ESP_CONSOLE_SECONDARY_NONE=y
CONFIG_PARTITION_TABLE_CUSTOM_FILENAME="boards/esp32s3-supermini-fh4r2/partitions.csv"
CONFIG_CC1101_SPI_SCLK_GPIO=12
CONFIG_CC1101_SPI_MISO_GPIO=13
CONFIG_CC1101_SPI_MOSI_GPIO=11
CONFIG_CC1101_SPI_CS_GPIO=10
CONFIG_CC1101_GDO0_GPIO=4
CONFIG_CC1101_GDO2_GPIO=5
# CONFIG_RF_ACTIVITY_LED_ENABLE is not set
```

## boards/xiao-esp32s3/sdkconfig.defaults
```kconfig
CONFIG_PLATFORM_BOARD_XIAO_ESP32S3=y
CONFIG_ESPTOOLPY_FLASHSIZE_8MB=y
CONFIG_SPIRAM_MODE_OCT=y
CONFIG_ESP_CONSOLE_USB_SERIAL_JTAG=y
CONFIG_ESP_CONSOLE_SECONDARY_NONE=y
CONFIG_PARTITION_TABLE_CUSTOM_FILENAME="boards/xiao-esp32s3/partitions.csv"
CONFIG_CC1101_SPI_SCLK_GPIO=7
CONFIG_CC1101_SPI_MISO_GPIO=8
CONFIG_CC1101_SPI_MOSI_GPIO=9
CONFIG_CC1101_SPI_CS_GPIO=4
CONFIG_CC1101_GDO0_GPIO=2
CONFIG_CC1101_GDO2_GPIO=1
CONFIG_RF_ACTIVITY_LED_ENABLE=y
CONFIG_RF_ACTIVITY_LED_GPIO=21
# CONFIG_RF_ACTIVITY_LED_ACTIVE_HIGH is not set
```

## components/cc1101/Kconfig
```kconfig
menu "CC1101 radio configuration"

    comment "Pins are validated against the selected board profile at runtime"

    config CC1101_SPI_SCLK_GPIO
        int "CC1101 SCK GPIO"
        range 0 33 if IDF_TARGET_ESP32
        range 0 48 if IDF_TARGET_ESP32S3
        default 12 if PLATFORM_BOARD_ESP32S3_DEVKITC_N16R8
        default 7 if PLATFORM_BOARD_XIAO_ESP32S3
        default 18

    config CC1101_SPI_MISO_GPIO
        int "CC1101 MISO/GDO1 GPIO"
        range 0 39 if IDF_TARGET_ESP32
        range 0 48 if IDF_TARGET_ESP32S3
        default 13 if PLATFORM_BOARD_ESP32S3_DEVKITC_N16R8
        default 8 if PLATFORM_BOARD_XIAO_ESP32S3
        default 19

    config CC1101_SPI_MOSI_GPIO
        int "CC1101 MOSI GPIO"
        range 0 33 if IDF_TARGET_ESP32
        range 0 48 if IDF_TARGET_ESP32S3
        default 11 if PLATFORM_BOARD_ESP32S3_DEVKITC_N16R8
        default 9 if PLATFORM_BOARD_XIAO_ESP32S3
        default 23

    config CC1101_SPI_CS_GPIO
        int "CC1101 CSN GPIO"
        range 0 33 if IDF_TARGET_ESP32
        range 0 48 if IDF_TARGET_ESP32S3
        default 10 if PLATFORM_BOARD_ESP32S3_DEVKITC_N16R8
        default 4 if PLATFORM_BOARD_XIAO_ESP32S3
        default 27

    config CC1101_GDO0_GPIO
        int "CC1101 GDO0 asynchronous TX GPIO"
        range 0 33 if IDF_TARGET_ESP32
        range 0 48 if IDF_TARGET_ESP32S3
        default 4 if PLATFORM_BOARD_ESP32S3_DEVKITC_N16R8
        default 2 if PLATFORM_BOARD_XIAO_ESP32S3
        default 26

    config CC1101_GDO2_GPIO
        int "CC1101 GDO2 asynchronous RX GPIO"
        range 0 39 if IDF_TARGET_ESP32
        range 0 48 if IDF_TARGET_ESP32S3
        default 5 if PLATFORM_BOARD_ESP32S3_DEVKITC_N16R8
        default 1 if PLATFORM_BOARD_XIAO_ESP32S3
        default 25

    config CC1101_XTAL_HZ
        int "CC1101 crystal frequency (Hz)"
        range 26000000 27000000
        default 26000000
        help
            Generic CC1101 V2.0 modules normally use a 26 MHz crystal.

    config CC1101_FREQUENCY_HZ
        int "RF center frequency (Hz)"
        range 387000000 464000000
        default 433920000

    config CC1101_TX_POWER_DBM
        int "Nominal CC1101 transmit power (dBm)"
        range -30 10
        default 5
        help
            Nominal reference-design value. Actual module power and legal limits vary.

    config CC1101_RX_INVERT
        bool "Invert GDO2 receive input in the ESP32 GPIO matrix"
        default n

endmenu
```

## components/ota_update/Kconfig
```kconfig
menu "Shared Web and LAN OTA HTTP server"

config OTA_HTTP_PORT
    int "Shared Web and LAN OTA HTTP port"
    range 80 65535
    default 80

config OTA_HTTP_TASK_STACK_SIZE
    int "Shared Web and LAN OTA HTTP server task stack size"
    range 8192 16384
    default 8192

endmenu
```

## components/platform_board/Kconfig
```kconfig
menu "RF bridge board profile"

    choice PLATFORM_BOARD_PROFILE
        prompt "Board profile"
        default PLATFORM_BOARD_ESP32_DEVKIT if IDF_TARGET_ESP32
        default PLATFORM_BOARD_ESP32S3_DEVKITC_N16R8 if IDF_TARGET_ESP32S3

        config PLATFORM_BOARD_ESP32_DEVKIT
            bool "Classic ESP32 DevKit/WROOM"
            depends on IDF_TARGET_ESP32

        config PLATFORM_BOARD_ESP32S3_DEVKITC_N16R8
            bool "ESP32-S3 DevKitC-compatible N16R8"
            depends on IDF_TARGET_ESP32S3

        config PLATFORM_BOARD_XIAO_ESP32S3
            bool "Seeed Studio XIAO ESP32-S3"
            depends on IDF_TARGET_ESP32S3
    endchoice

endmenu
```

## components/rf_automation/Kconfig
```kconfig
menu "RF automation configuration"

config RF_MAX_AUTOMATION_RULES
    int "Maximum persistent automation rules"
    range 1 32
    default 32
    help
        Maximum number of trigger-to-action rules loaded into bounded RAM.
        Startup fails automation closed if NVS contains more rules.

endmenu
```

## components/rf_ook/Kconfig
```kconfig
menu "OOK service configuration"

    config RF_DEFAULT_TX_REPEATS
        int "Default RF transmit repeats"
        range 1 20
        default 8

    config RF_DUPLICATE_WINDOW_MS
        int "Received duplicate suppression window (ms)"
        range 0 2000
        default 350

    config RF_ACTIVITY_LED_ENABLE
        bool "Enable the startup and RF activity LED"
        default n if PLATFORM_BOARD_ESP32S3_DEVKITC_N16R8
        default n if PLATFORM_BOARD_ESP32S3_SUPERMINI_FH4R2
        default y
        help
            Blinks a GPIO three times during application startup, with fixed 150 ms dark
            gaps, and pulses it after a decoded or raw frame passes validation and duplicate
            suppression. Official Espressif DevKitC V4 boards do not have a controllable
            GPIO LED; disable this option or attach an external LED on those boards.

    if RF_ACTIVITY_LED_ENABLE

        config RF_ACTIVITY_LED_GPIO
            int "RF activity LED GPIO"
            range 0 33 if IDF_TARGET_ESP32
            range 0 48 if IDF_TARGET_ESP32S3
            default 21 if PLATFORM_BOARD_XIAO_ESP32S3
            default 2
            help
                GPIO2 drives the active-high blue LED on many DOIT/clone DevKit V1 boards.
                GPIO2 is a boot-strapping pin, so external circuitry must not force an
                incompatible level during reset. Other ESP32 strapping outputs GPIO0,
                GPIO5, GPIO12, and GPIO15 are rejected at runtime.

        config RF_ACTIVITY_LED_ACTIVE_HIGH
            bool "RF activity LED is active-high"
            default n if PLATFORM_BOARD_XIAO_ESP32S3
            default y

        config RF_ACTIVITY_LED_PULSE_MS
            int "RF activity LED pulse duration (ms)"
            range 5 250
            default 25

    endif

endmenu
```

## components/rf_signals/Kconfig
```kconfig
menu "Learned RF signal service"

config RF_MAX_LEARNED_SIGNALS
    int "Maximum learned signals cached for live matching"
    range 1 64
    default 32
    help
        Maximum number of learned decoded/raw signals loaded into bounded RAM for
        annotating received events. NVS records above this limit remain readable
        and removable, but live learned-name annotation is disabled until the
        count is reduced.

endmenu
```

## components/web_ui/Kconfig
```kconfig
menu "RF Bridge Web UI"

config WEB_SSE_ENABLE
    bool "Enable Web UI Server-Sent Events"
    default y
    help
        Keep the bounded Server-Sent Events notification channel enabled. The Web UI
        retains its snapshot and polling fallback when this is disabled.

endmenu
```

## sdkconfig.defaults
```kconfig
CONFIG_COMPILER_OPTIMIZATION_SIZE=y
CONFIG_RF_ACTIVITY_LED_PULSE_MS=25
CONFIG_LOG_COLORS=y
CONFIG_BOOTLOADER_LOG_COLORS=y
CONFIG_PARTITION_TABLE_CUSTOM=y
CONFIG_BOOTLOADER_APP_ROLLBACK_ENABLE=y
CONFIG_OTA_HTTP_PORT=80
CONFIG_OTA_HTTP_TASK_STACK_SIZE=8192
# mDNS 1.11.3 indexes two slots in duplicate-interface detection even with only STA enabled.
CONFIG_MDNS_MAX_INTERFACES=2
CONFIG_MDNS_MAX_SERVICES=2
CONFIG_MDNS_ACTION_QUEUE_LEN=8
CONFIG_MDNS_TASK_STACK_SIZE=4096
CONFIG_MDNS_PREDEF_NETIF_STA=y
CONFIG_MDNS_PREDEF_NETIF_AP=n
CONFIG_MDNS_PREDEF_NETIF_ETH=n
CONFIG_MDNS_ENABLE_CONSOLE_CLI=n
CONFIG_MDNS_MULTIPLE_INSTANCE=n
CONFIG_MQTT_PROTOCOL_311=y
# CONFIG_MQTT_PROTOCOL_5 is not set
# CONFIG_MQTT_TRANSPORT_SSL is not set
# CONFIG_MQTT_TRANSPORT_WEBSOCKET is not set
# CONFIG_MQTT_TRANSPORT_WEBSOCKET_SECURE is not set
CONFIG_MQTT_SKIP_PUBLISH_IF_DISCONNECTED=y
CONFIG_MQTT_REPORT_DELETED_MESSAGES=y
```

## sdkconfig.defaults.esp32s3
```kconfig
CONFIG_ESPTOOLPY_FLASHMODE_DIO=y
CONFIG_ESPTOOLPY_FLASHFREQ_40M=y
CONFIG_SPIRAM=y
CONFIG_SPIRAM_TYPE_AUTO=y
CONFIG_SPIRAM_SPEED_80M=y
CONFIG_SPIRAM_BOOT_HW_INIT=y
CONFIG_SPIRAM_BOOT_INIT=y
# CONFIG_SPIRAM_IGNORE_NOTFOUND is not set
CONFIG_SPIRAM_USE_MALLOC=y
CONFIG_SPIRAM_MEMTEST=y
CONFIG_SPIRAM_TRY_ALLOCATE_WIFI_LWIP=y
CONFIG_SPIRAM_MALLOC_ALWAYSINTERNAL=16384
CONFIG_SPIRAM_MALLOC_RESERVE_INTERNAL=65536
# CONFIG_FREERTOS_TASK_CREATE_ALLOW_EXT_MEM is not set
```

## test_apps/unit/sdkconfig.defaults.esp32
```kconfig
CONFIG_PLATFORM_BOARD_ESP32_DEVKIT=y
CONFIG_ESPTOOLPY_FLASHSIZE_4MB=y
CONFIG_ESP_CONSOLE_UART_DEFAULT=y
CONFIG_CC1101_SPI_SCLK_GPIO=18
CONFIG_CC1101_SPI_MISO_GPIO=19
CONFIG_CC1101_SPI_MOSI_GPIO=23
CONFIG_CC1101_SPI_CS_GPIO=27
CONFIG_CC1101_GDO0_GPIO=26
CONFIG_CC1101_GDO2_GPIO=25
CONFIG_RF_ACTIVITY_LED_ENABLE=y
CONFIG_RF_ACTIVITY_LED_GPIO=2
CONFIG_RF_ACTIVITY_LED_ACTIVE_HIGH=y
```

## test_apps/unit/sdkconfig.defaults.esp32s3
```kconfig
CONFIG_PLATFORM_BOARD_ESP32S3_DEVKITC_N16R8=y
CONFIG_ESPTOOLPY_FLASHSIZE_16MB=y
CONFIG_ESPTOOLPY_FLASHMODE_DIO=y
CONFIG_ESPTOOLPY_FLASHFREQ_40M=y
CONFIG_ESP_CONSOLE_UART_DEFAULT=y
CONFIG_ESP_CONSOLE_SECONDARY_NONE=y
CONFIG_CC1101_SPI_SCLK_GPIO=12
CONFIG_CC1101_SPI_MISO_GPIO=13
CONFIG_CC1101_SPI_MOSI_GPIO=11
CONFIG_CC1101_SPI_CS_GPIO=10
CONFIG_CC1101_GDO0_GPIO=4
CONFIG_CC1101_GDO2_GPIO=5
# CONFIG_RF_ACTIVITY_LED_ENABLE is not set
CONFIG_SPIRAM=y
CONFIG_SPIRAM_MODE_OCT=y
CONFIG_SPIRAM_TYPE_AUTO=y
CONFIG_SPIRAM_SPEED_80M=y
CONFIG_SPIRAM_BOOT_HW_INIT=y
CONFIG_SPIRAM_BOOT_INIT=y
# CONFIG_SPIRAM_IGNORE_NOTFOUND is not set
CONFIG_SPIRAM_USE_MALLOC=y
CONFIG_SPIRAM_MEMTEST=y
CONFIG_SPIRAM_TRY_ALLOCATE_WIFI_LWIP=y
CONFIG_SPIRAM_MALLOC_ALWAYSINTERNAL=16384
CONFIG_SPIRAM_MALLOC_RESERVE_INTERNAL=65536
# CONFIG_FREERTOS_TASK_CREATE_ALLOW_EXT_MEM is not set
```
